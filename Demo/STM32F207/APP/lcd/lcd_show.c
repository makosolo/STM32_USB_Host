#include "stm32f2xx.h"

#include "ascii.h"
#include "lcd.h"
#include "lcd_show.h"

/*******************************************************************************
* 函数名	: LCD_printc
* 描述  	: 显示字符函数
* 		      横向取模左高位,数据排列:从左到右从上到下
* 参数  	: -  x  :x轴坐标
*			  -  y  :y轴坐标
*			  -c_dat:要显示的字符
*			  -size :字号，size为12、16、24、32、40、48分别是6*12、8*16、12*24、
*				     16*32、20*40、24*48
*			  -  b  :显示模式；1正常；0反白
* 返回值	: 无
*******************************************************************************/
void LCD_printc(u16 x, u16 y, char c_dat,u8 size,u8 b)
{
	u16 i,j,k;
	u8 num = 8;	
	u32 c;
	c_dat -= 32;
 
	if(size == 24)			 //12x24或16x32
	{	
		for(i=0;i<size;i++)
		{
			for(j=0;j<2;j++)
			{
				if(size==24)c = ascii_12x24[c_dat][i*2+j];
				if(b==0){c=~c;}
				if((size==24)&&(j==1))num=4;
				else num=8;
				for(k=0;k<num;k++)
				{
					if(c&0x80)
					{	
						POINT_COLOR = WHITE;
					}
					else
					{
						POINT_COLOR = BLUE;
					}
					LCD_DrawPoint(x+j*8+k,y+i);
					c<<=1;
				}
			}
		}	
	}
}

/*******************************************************************************
* 函数名	: LCD_prints
* 描述  	: 显示字符串函数
* 参数  	: -  x  :x轴坐标
*			  -  y  :y轴坐标
*			  -s_dat:要显示的字符串
*			  -size :字号，size为12、16、24、32、40、48分别是6*12、8*16、12*24、
*				     16*32、20*40、24*48
*			  -  b  :显示模式；1正常；0反白
* 返回值	: 无
*******************************************************************************/
void LCD_prints(u16 x, u16 y, char *s_dat,u8 size,u8 b)
{		
    while((*s_dat<='')&&(*s_dat>=' '))//判断是不是非法字符!
	{
		if((x>480)||(y>320)) break;		//超出屏幕范围
		LCD_printc(x, y, *s_dat,size,b); 
		s_dat++;
		x+=size/2;
	}
}
